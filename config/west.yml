## config/west.yml
```yaml
manifest:
  remotes:
    - name: zmkfirmware
      url-base: https://github.com/zmkfirmware
    - name: H1r0k1kun
      url-base: https://github.com/H1r0k1kun
    - name: prospector
      url-base: https://github.com/t-ogura
    - name: kot149
      url-base: https://github.com/kot149
  projects:
    - name: zmk
      remote: zmkfirmware
      revision: main
      import: app/west.yml
    - name: zmk-pmw3610-driver
      remote: H1r0k1kun
      revision: main
    - name: prospector-zmk-module
      remote: prospector
      revision: v1.0.0
      path: modules/prospector-zmk-module
    - name: zmk-scroll-snap
      remote: kot149
      revision: v1
  self:
    path: config
```
